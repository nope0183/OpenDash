#pragma once

static const char SHFW_CATALOG_CSV[] = R"SHFW(01,08,510013014502E803,FFFFFFFFFFFFFFFF,DPC curve 20A 0.9quadratic ()0.01Ax4,1e
05,08,F4003903D006B80B,FFFFFFFFFFFFFFFF,DPC curve 20A 0.9quadratic ()0.01Ax4,1d
09,08,A20026028B04D007,FFFFFFFFFFFFFFFF,DPC curve 20A 0.9quadratic ()0.01Ax4,1s
0D,08,F400CF0392083C0F,FFFFFFFFFFFFFFFF,Braking curve 28A 0.9quadratic ()0.01Ax4,1
11,01,64,FF,speed limit (1-100)km/h,1s
12,01,49,FF,speed limit (1-100)km/h,1d
13,01,00,FF,speed limit (1-100)km/h,1e
14,01,03,FF,Motor Start speed (0-10)km/h,
14,02,0364,00FF,Brake boost (0-100)%,
16,02,0200,0200,Disable Boot beep,
16,02,0100,0100,Swap button Functions,
16,02,8000,8000,speed limit ,1s
16,02,4000,4000,speed limit ,1d
16,02,2000,2000,speed limit ,1e
16,02,0020,0020,Field weakening,1e
16,02,0010,0010,Field weakening,1d
16,02,0008,0008,Field weakening,1s
19,01,00,FF,Cruise control :Off,
19,01,01,FF,Cruise control :Time,
19,01,02,FF,Cruise control :Single tap,
19,01,03,FF,Cruise control :Dubble tap,
1B,01,00,FF,Default Mode :Drive,
1B,01,01,FF,Default Mode :Eco,
1B,01,02,FF,Default Mode :Sport,
1B,01,03,FF,Default Mode :Last,
1C,01,05,FF,Brake min speed(0-10)km/h,1
1C,02,0564,00FF,Brake phpase current limit (lq) (0-100)A,
1D,02,0010,00FF,Autobraking (0-65)A,
20,02,1E41,00FF,Torque phpase current limit (lq) (0-100)A,
20,01,1E,FF,Field phpase current limit (lq) (0-100)A,
21,02,0064,00FF,Acceleration boost (0-100)%,
22,02,0001,0001,Disable mode :Sport,
22,02,8000,8000,Disable mode :Drive,
22,02,4000,4000,Disable mode :Eco,
22,02,2200,2000,Disable DPC smoothing,
22,02,0800,0800,Motor PWM overmodulation,1e
22,02,0400,0400,Motor PWM overmodulation,1d
22,02,0200,0200,Motor PWM overmodulation,1s
22,02,0100,0100,Negative start speed,
25,01,00,FF,Positive battery current limit,
1E,01,41,FF,Field weakening Start Speed (0-65)km/h,
1E,02,410F,00FF,Initial field curent (0-15)A,
1F,01,FA,FF,Variable field current(0-2500) 10mA*km/H,
23,01,00,FF,Taillight mode while not baking: Off,
23,01,01,FF,Taillight mode while not baking: On,
23,01,02,FF,Taillight mode while not baking: Flashing,
23,01,03,FF,Taillight mode while not baking: Full brightness,
23,02,0000,00FF,Taillight mode while baking: Off,
23,02,0001,00FF,Taillight mode while baking: On,
23,02,0002,00FF,Taillight mode while baking: Flashing,
23,02,0003,00FF,Taillight mode while baking: Full brightness,
24,01,00,FF,Taillight mode while not baking with headlight on: Off,
24,01,01,FF,Taillight mode while not baking with headlight on: On,
24,01,02,FF,Taillight mode while not baking with headlight on: Flashing,
24,01,03,FF,Taillight mode while not baking with headlight on: Full brightness,
24,02,0000,00FF,Taillight mode while baking with headlight on: Off,
24,02,0001,00FF,Taillight mode while baking with headlight on: On,
24,02,0002,00FF,Taillight mode while baking with headlight on: Flashing,
24,02,0003,00FF,Taillight mode while baking with headlight on: Full brightness,
1F,02,FA19,00FF,Taillight smoothing (0-25),
16,02,0408,0400,Always on headlight,
17,01,00,FF,Dashboard Idle data type: Off,
17,01,02,FF,Dashboard Idle data type: Averge speed (km/h),
17,01,0A,FF,Dashboard Idle data type: Averge speed (mp/h),
17,01,0B,FF,Dashboard Idle data type: Averge speed (m/s),
17,01,04,FF,Dashboard Idle data type: Trip mileage (km),
17,01,13,FF,Dashboard Idle data type: Remaining mileage (km),
17,01,0E,FF,Dashboard Idle data type: Battery temperature,
17,01,05,FF,Dashboard Idle data type: Battery level,
17,01,06,FF,Dashboard Idle data type: Voltage,
17,01,03,FF,Dashboard Idle data type: Uptime,
17,01,0F,FF,Dashboard Idle data type: Throttle value,
17,01,10,FF,Dashboard Idle data type: Brake value,
17,02,0008,00FF,Dashboard Drive data type: Speed (km/h),
17,02,0007,00FF,Dashboard Drive data type: Speed (mp/h),
17,02,0009,00FF,Dashboard Drive data type: Speed (m/s),
17,02,0002,00FF,Dashboard Drive data type: Average speed (km/h),
17,02,000A,00FF,Dashboard Drive data type: Average speed (mp/h),
17,02,000B,00FF,Dashboard Drive data type: Average speed (m/s),
17,02,0004,00FF,Dashboard Drive data type: Trip mileage (km),
17,02,0013,00FF,Dashboard Drive data type: Rrmaining mileage (km),
17,02,000E,00FF,Dashboard Drive data type: Battery temperature,
17,02,0005,00FF,Dashboard Drive data type: Battery level,
17,02,0006,00FF,Dashboard Drive data type: Voltage,
17,02,0011,00FF,Dashboard Drive data type: Current,
17,02,0016,00FF,Dashboard Drive data type: Phase current,
17,02,0012,00FF,Dashboard Drive data type: Power (10W),
17,02,0003,00FF,Dashboard Drive data type: Uptime,
18,01,00,FF,Dashboard Alternating data type:Off,
18,01,08,FF,Dashboard Alternating data type:Speed (km/h),
18,01,07,FF,Dashboard Alternating data type:Speed (mp/h),
18,01,09,FF,Dashboard Alternating data type:Speed (m/s),
18,01,02,FF,Dashboard Alternating data type:Avarage Speed (km/h),
18,01,0A,FF,Dashboard Alternating data type:Avarage Speed (mp/h),
18,01,0B,FF,Dashboard Alternating data type:Avarage Speed (m/s),
18,01,0D,FF,Dashboard Alternating data type:CC Speed (km/h),
18,01,0C,FF,Dashboard Alternating data type:CC Speed (mp/h),
18,01,04,FF,Dashboard Alternating data type:Trip mileage (km),
18,01,13,FF,Dashboard Alternating data type:Remaining mileage (km),
18,01,0E,FF,Dashboard Alternating data type:Battery temperature,
18,01,05,FF,Dashboard Alternating data type:Battery level,
18,01,06,FF,Dashboard Alternating data type:Voltage,
18,01,11,FF,Dashboard Alternating data type:Current,
18,01,16,FF,Dashboard Alternating data type:Phase current,
18,01,12,FF,Dashboard Alternating data type:Power (10W),
18,01,03,FF,Dashboard Alternating data type:Uptime,
18,02,0000,00FF,Battery bar data type: Off,
18,02,0001,00FF,Battery bar data type: Throttle value,
18,02,0002,00FF,Battery bar data type: Brake value,
18,02,0003,00FF,Battery bar data type: Current of max A,
18,02,0004,00FF,Battery bar data type: % of speed limit,
18,02,0005,00FF,Battery bar data type: Active profile,
1B,02,0300,00FF,Profile Activation Beep type :None ,
1B,02,0301,FFFF,Profile Activation Beep type :Single,
1B,02,0302,FFFF,Profile Activation Beep type :Long,
1B,02,0303,FFFF,Profile Activation Beep type :Double,
1B,02,0304,FFFF,Profile Activation Beep type :Extra Long,
B2,02,0100,FF00,Active profile (1-3),Global
B3,02,0100,FF00,Boot profile (0-3),
B4,02,0300,FF00,Boot profile with bake handle pressed (0-3),
B5,02,0200,FF00,Boot profile with accelerator pressed (0-3),
B6,02,0300,FF00,Boot profile with accelerator and bake handle pressed (0-3),
B7,02,0300,FF00,Button press with with bake handle pressed (0-3),
B8,02,0300,FF00,Button double press with with bake handle pressed (0-3),
B9,02,0300,FF00,Accelerator and brake handle pressed profile (0-3),
F7,02,1E00,FF00,auto-shutdown delay (0-30)min,
F8,02,3C00,FF00,auto shutdown delay when locked,
F6,02,5100,FF00,taillight brightnes (1-100)%,
FE,02,4000,4000,no break light with autobraking,
E9,02,3412,FFFF,spoof BLE version(0.0.0.0-15.15.15.15.15),
EA,02,0010,FFFF,spoof ESC version(0.0.0.0-15.15.15.15.15),
EB,02,0010,FFFF,spoof BMS version(0.0.0.0-15.15.15.15.15),
ED,02,0100,0100,Supress all errors,
ED,02,1000,1000,Supress general motor errors,
ED,02,4000,4000,Supress general ESC errors,
ED,02,0400,0400,Supress general BMS errors,
ED,02,0800,0800,Supress motor temprature errors,
ED,02,2000,2000,Supress ESC temprature errors,
ED,02,0200,0200,Supress BMS temprature errors,
ED,02,8000,8000,Supress accelerator and bake handle errors,
FE,02,8000,8000,Require a key,
FE,02,0200,0200,Disable Charging mode,
FB,02,0C12,FFFF,Max ADC resistor divider voltage () 0.1V,
F9,02,5D00,FF00,Wheel size (in 0.1 inch),
F1,02,1800,FF00,Motor PWM Frequency (4-24),
F7,02,1E00,FFFF,auto-shutdown delay (in m 0-30),g
FE,02,1000,1000,Switch off motor without throttle,
FE,02,0001,0001,Enable new Max Motors(PxxH),
F5,01,37,FF,min throttle value (30-max),
F5,02,37B7,00FF,max throttle value (min-210),
F4,01,37,FF,min brake value (30-max),
F4,02,37B7,00FF,max brake value (min-210),
F3,01,1E,FF,Constant Kp (1-50),
F3,02,1E32,00FF,Constant Ki (10-120),
F2,01,0F,FF,Constant Kd (1-50),
F2,02,0F00,00FF,Negative current limit (0-65)A,
FA,02,0000,FFFF,BMS emulation= (no - 20S) (0-11),
FC,02,C43B,FFFF,Battery Capacity (in mAh),
FD,01,28,FF,Min cell voltage =3.1V,
FD,02,2837,00FF,Max cell voltage =4.15V,
7A,02,E803,FFFF,Current Limit in 10mA(0-100)A,3e
89,02,0019,00FF,Current smoothness in 0.1A (0.1-2.5)A,3e
16,02,1000,1000,S mode only,
BA,08,0212124300000000,FFFFFFFFFFFFFFFF,custom profile trigger(2:t;b;t;b;s;d;),
BA,08,0012124300000000,FFFFFFFFFFFFFFFF,off b=1 t=2 s=3 d=4,
BA,08,0212234100000000,FFFFFFFFFFFFFFFF,custom profile trigger(2:t;b;s;t;b;d;),
BA,08,0212120300000000,FFFFFFFFFFFFFFFF,custom profile trigger(2:t;b;t;b;s),
BA,08,0232010000000000,FFFFFFFFFFFFFFFF,custom profile trigger(2:t;s;b),
)SHFW";

static constexpr uint16_t SHFW_CATALOG_COUNT = 168;
